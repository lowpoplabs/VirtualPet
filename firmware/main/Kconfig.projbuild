## firmware/main/Kconfig.projbuild
```kconfig
menu "VirtualPet"

    choice PET_BOARD
        prompt "Target board"
        default PET_BOARD_WATCH_206
        help
            Picks the Waveshare board support package. Set by
            sdkconfig.defaults.watch / sdkconfig.defaults.square; build with
            firmware/build.ps1 rather than changing it by hand.

        config PET_BOARD_WATCH_206
            bool "ESP32-S3-Touch-AMOLED-2.06 (watch, 410x502)"

        config PET_BOARD_SQUARE_216
            bool "ESP32-S3-Touch-AMOLED-2.16 (board, 480x480)"
    endchoice

    config PET_TEST_BUILD
        bool "Test build (never trades with a release build)"
        default n
        help
            For trying the exchange without risking the owner's pet. A test
            build is in the test realm, as the simulator and the phone's
            test app are: it trades only with other test builds. It keeps
            its pet in a save of its own, so flashing it over a release
            build leaves that pet untouched, to be found again when the
            release build is flashed back. Build with
            firmware/build.ps1 -Board watch -Test.

endmenu
```
